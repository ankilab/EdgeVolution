## CMakeLists.txt
```
cmake_minimum_required(VERSION 3.20.0)

set(CMAKE_CXX_STANDARD 17)
set(CMAKE_CXX_STANDARD_REQUIRED ON)
set(CMAKE_CXX_EXTENSIONS OFF)
unset(CONFIG_STD_CPP11)
set(CONFIG_STD_CPP17 y)
    

find_package(Zephyr PATHS /home/EvoNAS_bump/tflite/zephyr)
#find_package(Zephyr REQUIRED HINTS $ENV{ZEPHYR_BASE})

project(EvoNAS_tflite_micro)

# These samples use local static initialization. Since Zephyr doesn't support the
# C++ ABI for thread-safe initialization of local statics and the constructors don't
# appear to require thread safety, we turn it off in the C++ compiler.
# set(NO_THREADSAFE_STATICS $<TARGET_PROPERTY:compiler-cpp,no_threadsafe_statics>)
#zephyr_compile_options($<$<COMPILE_LANGUAGE:CXX>:${NO_THREADSAFE_STATICS}>)
# set_property(TARGET tgt PROPERTY CXX_STANDARD 17)


file(GLOB app_sources src/*)
target_sources(app PRIVATE ${app_sources})
```

## prj.conf
```kconfig
# Copyright 2019 The TensorFlow Authors. All Rights Reserved.
#
# Licensed under the Apache License, Version 2.0 (the "License");
# you may not use this file except in compliance with the License.
# You may obtain a copy of the License at
#
#    http://www.apache.org/licenses/LICENSE-2.0
#
# Unless required by applicable law or agreed to in writing, software
# distributed under the License is distributed on an "AS IS" BASIS,
# WITHOUT WARRANTIES OR CONDITIONS OF ANY KIND, either express or implied.
# See the License for the specific language governing permissions and
# limitations under the License.
# ==============================================================================s
CONFIG_CPLUSPLUS=y
CONFIG_LIB_CPLUSPLUS=y
CONFIG_NEWLIB_LIBC=y
CONFIG_TENSORFLOW_LITE_MICRO=y
CONFIG_MAIN_STACK_SIZE=2048
CONFIG_USB_DEVICE_STACK=y
CONFIG_USB_DEVICE_PRODUCT="Zephyr USB airway"
CONFIG_USB_CDC_ACM=y
CONFIG_SERIAL=y
CONFIG_CONSOLE=y
CONFIG_UART_CONSOLE=y
CONFIG_UART_LINE_CTRL=y
```

## src/main.c
```c
/*
 * Copyright 2020 The TensorFlow Authors. All Rights Reserved.
 *
 * Licensed under the Apache License, Version 2.0 (the "License");
 * you may not use this file except in compliance with the License.
 * You may obtain a copy of the License at
 *
 *     http://www.apache.org/licenses/LICENSE-2.0
 *
 * Unless required by applicable law or agreed to in writing, software
 * distributed under the License is distributed on an "AS IS" BASIS,
 * WITHOUT WARRANTIES OR CONDITIONS OF ANY KIND, either express or implied.
 * See the License for the specific language governing permissions and
 * limitations under the License.
 */

#include "main_functions.h"

/* Increase number of loops to see full period of the sine curve */
#define NUM_LOOPS 1000

/* This is the default main used on systems that have the standard C entry
 * point. Other devices (for example FreeRTOS or ESP32) that have different
 * requirements for entry code (like an app_main function) should specialize
 * this main.cc file in a target-specific subfolder.
 */
int main(int argc, char *argv[])
{
	setup();
	/* Note: Modified from original while(true) to accommodate CI */
	for (int i = 0; i < NUM_LOOPS; i++) {
		loop();
	}
	return 0;
}
```

## src/main_functions.cpp
```c
/*
 * Copyright 2020 The TensorFlow Authors. All Rights Reserved.
 *
 * Licensed under the Apache License, Version 2.0 (the "License");
 * you may not use this file except in compliance with the License.
 * You may obtain a copy of the License at
 *
 *     http://www.apache.org/licenses/LICENSE-2.0
 *
 * Unless required by applicable law or agreed to in writing, software
 * distributed under the License is distributed on an "AS IS" BASIS,
 * WITHOUT WARRANTIES OR CONDITIONS OF ANY KIND, either express or implied.
 * See the License for the specific language governing permissions and
 * limitations under the License.
 */

#include "main_functions.h"

#include "constants.h"
#include "model.hpp"
#include "tensorflow/lite/micro/micro_mutable_op_resolver.h"
#include "tensorflow/lite/micro/micro_interpreter.h"
#include "tensorflow/lite/schema/schema_generated.h"
#include <tensorflow/lite/micro/kernels/micro_ops.h>

#include <math.h>
#include <stdint.h>

#include <zephyr/kernel.h>
#include <zephyr/sys/printk.h>
#include <zephyr/usb/usb_device.h>
#include <zephyr/drivers/uart.h>
#include <zephyr/drivers/gpio.h>

#define LED0_NODE DT_ALIAS(led0)
static const struct gpio_dt_spec led = GPIO_DT_SPEC_GET(LED0_NODE, gpios);



/* Globals, used for compatibility with Arduino-style sketches. */
namespace {
	// tflite::ErrorReporter *error_reporter = nullptr;
	const tflite::Model *model = nullptr;
	tflite::MicroInterpreter *interpreter = nullptr;

	//constexpr int kTensorArenaSize = 170 * 1024;
	constexpr int kTensorArenaSize = 230 * 1024;
	uint8_t tensor_arena[kTensorArenaSize];
}  /* namespace */

uint8_t setup_failed = 1;


/* The name of this function is important for Arduino compatibility. */
void setup(void)
{
	/* Initialize LED. */
	if (!device_is_ready(led.port)) {
		return;
	}
	gpio_pin_configure_dt(&led, GPIO_OUTPUT_ACTIVE);

	/* Initialize UART USB communication. */
	const struct device *dev = DEVICE_DT_GET(DT_CHOSEN(zephyr_console));
	uint32_t dtr = 0;

	if (usb_enable(NULL)) {
		return;
	}

	/* Poll if the DTR (Data Terminal Ready) flag was set, and only then continue. */
	while (!dtr) {
		uart_line_ctrl_get(dev, UART_LINE_CTRL_DTR, &dtr);
		/* Toggle LED until DTR flag was set. */
		gpio_pin_toggle_dt(&led);		
		/* Give CPU resources to low priority threads. */
		k_sleep(K_MSEC(100));
	}


	model = tflite::GetModel(g_model);
	if (model->version() != TFLITE_SCHEMA_VERSION) {
		printk("Version error");
		return;
	}


	// Create OpResolver class with up to 26 kernel support.
	using KeywordOpResolver = tflite::MicroMutableOpResolver<26>;

	KeywordOpResolver* op_resolver = new KeywordOpResolver();
	op_resolver->AddFullyConnected();
	op_resolver->AddReshape();
	op_resolver->AddSoftmax();
	op_resolver->AddTranspose();
	op_resolver->AddSlice();
	op_resolver->AddGather();
	op_resolver->AddMul();
	op_resolver->AddPack();
	op_resolver->AddSum();
	op_resolver->AddQuantize();
	op_resolver->AddDequantize();
	op_resolver->AddDepthwiseConv2D();
	op_resolver->AddMaxPool2D();
	op_resolver->AddAdd();
	op_resolver->AddConv2D();
	op_resolver->AddSquaredDifference();
	op_resolver->AddRsqrt();
	op_resolver->AddSub();
	op_resolver->AddSqrt();
	op_resolver->AddSquare();
	op_resolver->AddMean();
	op_resolver->AddReduceMax();
	op_resolver->AddAveragePool2D();
	op_resolver->AddExpandDims();
	op_resolver->AddShape();
	op_resolver->AddConcatenation();


	static tflite::MicroInterpreter static_interpreter(model, *op_resolver, tensor_arena, kTensorArenaSize, nullptr, nullptr);
	interpreter = &static_interpreter;

	/* Allocate memory from the tensor_arena for the model's tensors. */
	interpreter->AllocateTensors();

	size_t size = interpreter->arena_used_bytes();
	printk("size : %d \n", size);

	setup_failed = 0;

	if (setup_failed){
		printk("Setup failed\n");
		return;
	}

	int64_t all_times = 0;
	int64_t time_stamp;
	int64_t milliseconds_spent;


	// start time measurement
	time_stamp = k_uptime_get();
	printk("now invoking...\n");

	TfLiteStatus invoke_status = interpreter->Invoke();
	if (invoke_status != kTfLiteOk) {
			printk("Invoke error\n");
			return;
	}

	milliseconds_spent = k_uptime_delta(&time_stamp);
	all_times += milliseconds_spent;
	printk("Time: %d\n", (int32_t)(milliseconds_spent));
	printk("InfTime: %d%d\n", (int32_t)(milliseconds_spent >> 32), (int32_t)(milliseconds_spent));
	k_sleep(K_SECONDS(5));



	delete[] op_resolver;


}

/* The name of this function is important for Arduino compatibility. */
void loop(void)
{	



}
```

## src/output_handler.cpp
```c
/*
 * Copyright 2020 The TensorFlow Authors. All Rights Reserved.
 *
 * Licensed under the Apache License, Version 2.0 (the "License");
 * you may not use this file except in compliance with the License.
 * You may obtain a copy of the License at
 *
 *     http://www.apache.org/licenses/LICENSE-2.0
 *
 * Unless required by applicable law or agreed to in writing, software
 * distributed under the License is distributed on an "AS IS" BASIS,
 * WITHOUT WARRANTIES OR CONDITIONS OF ANY KIND, either express or implied.
 * See the License for the specific language governing permissions and
 * limitations under the License.
 */

#include "output_handler.hpp"

void HandleOutput(tflite::ErrorReporter *error_reporter, float x_value,
		  float y_value)
{
	/* Log the current X and Y values */
	TF_LITE_REPORT_ERROR(error_reporter, "x_value: %f, y_value: %f\n",
			     static_cast < double > (x_value),
			     static_cast < double > (y_value));
	
}
```

## src/show_ops.cpp
```c
/*
 * Copyright 2020 The TensorFlow Authors. All Rights Reserved.
 *
 * Licensed under the Apache License, Version 2.0 (the "License");
 * you may not use this file except in compliance with the License.
 * You may obtain a copy of the License at
 *
 *     http://www.apache.org/licenses/LICENSE-2.0
 *
 * Unless required by applicable law or agreed to in writing, software
 * distributed under the License is distributed on an "AS IS" BASIS,
 * WITHOUT WARRANTIES OR CONDITIONS OF ANY KIND, either express or implied.
 * See the License for the specific language governing permissions and
 * limitations under the License.
 */

#include "show_ops.h"

#include "model.hpp"
#include "tensorflow/lite/micro/micro_mutable_op_resolver.h"
#include "tensorflow/lite/micro/micro_interpreter.h"
#include "tensorflow/lite/schema/schema_generated.h"
#include <tensorflow/lite/micro/kernels/micro_ops.h>
#include "tensorflow/lite/micro/micro_graph.h"
#include "tensorflow/lite/schema/schema_generated.h"
#include "flatbuffers/flatbuffers.h" // from @flatbuffers
#include "tensorflow/lite/micro/flatbuffer_utils.h"
#include "tensorflow/lite/schema/schema_utils.h"

#include <math.h>
#include <stdint.h>

#include <zephyr/kernel.h>
#include <zephyr/sys/printk.h>
#include <zephyr/usb/usb_device.h>
#include <zephyr/drivers/uart.h>
#include <zephyr/drivers/gpio.h>

#define LED0_NODE DT_ALIAS(led0)
static const struct gpio_dt_spec led = GPIO_DT_SPEC_GET(LED0_NODE, gpios);

namespace tflite
{

	// tflite::ErrorReporter *error_reporter = nullptr;
	const Model *model = nullptr;

	__attribute__((optimize(0))) void print_ops(void)
	{
		/* Initialize LED. */
		if (!device_is_ready(led.port)) {
			return;
		}
		gpio_pin_configure_dt(&led, GPIO_OUTPUT_ACTIVE);

		/* Initialize UART USB communication. */
		const struct device *dev = DEVICE_DT_GET(DT_CHOSEN(zephyr_console));
		uint32_t dtr = 0;

		if (usb_enable(NULL)) {
			return;
		}

		// // /* Poll if the DTR (Data Terminal Ready) flag was set, and only then continue. */
		while (!dtr) {
			uart_line_ctrl_get(dev, UART_LINE_CTRL_DTR, &dtr);
			/* Toggle LED until DTR flag was set. */
			gpio_pin_toggle_dt(&led);		
			/* Give CPU resources to low priority threads. */
			k_sleep(K_MSEC(100));
		}	
		printk("connected");

		model = tflite::GetModel(g_model);

		for (unsigned int subgraph_idx = 0; subgraph_idx < model->subgraphs()->size(); subgraph_idx++)
		{
			const SubGraph *subgraph = model->subgraphs()->Get(subgraph_idx);
			TFLITE_DCHECK(subgraph != nullptr);

			auto *opcodes = model->operator_codes();
			uint32_t operators_size = NumSubgraphOperators(subgraph);

			// print the built in codes for the operations
			for (size_t i = 0; i < operators_size; ++i)
			{
				const auto *op = subgraph->operators()->Get(i);
				const size_t index = op->opcode_index();
				const auto *opcode = opcodes->Get(index);
				auto builtin_code = GetBuiltinCode(opcode);
				printk("opcode %i \n", builtin_code);
			}
		}
	}

}
void print_ops(void)
{
	tflite::print_ops();
}
```

## src/show_ops.h
```c
/*
 * Copyright 2020 The TensorFlow Authors. All Rights Reserved.
 *
 * Licensed under the Apache License, Version 2.0 (the "License");
 * you may not use this file except in compliance with the License.
 * You may obtain a copy of the License at
 *
 *     http://www.apache.org/licenses/LICENSE-2.0
 *
 * Unless required by applicable law or agreed to in writing, software
 * distributed under the License is distributed on an "AS IS" BASIS,
 * WITHOUT WARRANTIES OR CONDITIONS OF ANY KIND, either express or implied.
 * See the License for the specific language governing permissions and
 * limitations under the License.
 */


#ifndef TENSORFLOW_PRINT_OPERATIONS_H_
#define TENSORFLOW_PRINT_OPERATIONS_H_
#ifdef __cplusplus
extern "C" {
#endif


void print_ops(void);



#ifdef __cplusplus
}
#endif

#endif /* TENSORFLOW_PRINT_OPERATIONS_H_ */
```
